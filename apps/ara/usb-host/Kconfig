## apps/ara/usb-host/Kconfig
```kconfig
#
# For a description of the syntax of this configuration file,
# see misc/tools/kconfig-language.txt.
#

config ARA_USB_HOST
	bool "Ara USB Host validation app"
	default n
	depends on ARCH_CHIP_TSB
	depends on ARCH_CHIP_USB_HCD

if ARA_UNIPRO_MAIN

config ARA_USB_HOST_PROGNAME
	string "Program name"
	default "usb_host"
	depends on BUILD_KERNEL
	---help---
		This is the name of the program that will be use when the NSH ELF
		program is installed.

endif
```

## nuttx/drivers/greybus/Kconfig
```kconfig
config GREYBUS_GPIO_PHY
	bool "GPIO PHY support"
	select GPIO
	default n

config GREYBUS_I2C_PHY
	bool "I2C PHY support"
	select I2C
	select I2C_TRANSFER
	default n

config GREYBUS_USB_PHY
	bool "USB Host PHY support"
	depends on ARCH_HAVE_USB_HOST
	default n
```
